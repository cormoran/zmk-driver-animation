/*
 * Copyright (c) 2025 cormoran
 * Copyright (c) 2026 cormoran
 *
 * SPDX-License-Identifier: MIT
 */

#include <dt-bindings/zmk_driver_animation/animation_control.h>

/ {
    behaviors {
        animls: animls {
            compatible = "zmk,behavior-animation-layer-status";
            #binding-cells = <2>;
            display-name = "Animation Layer Status";
        };
    };

    animation_layer_status: animation_layer_status {
        compatible = "zmk,animation-layer-status";
        status = "okay";
        default-color = <HSL(240, 100, 50)>; /* blue */
        /* Boards should override `pixels` and `colors`. */
    };
};
