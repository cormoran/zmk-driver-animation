## dts/bindings/behaviors/zmk,behavior-animation-layer-status.yaml
```yaml
# Copyright (c) 2025 cormoran
# SPDX-License-Identifier: MIT

description: |
  Peripheral-side receiver for the central->peripheral layer-status relay
  (DESIGN.md #3.7/#3.8 - a quarantined transport hack, not a general-purpose
  behavior).

compatible: "zmk,behavior-animation-layer-status"

include: two_param.yaml
```

## dts/bindings/behaviors/zmk,behavior-animation-trigger.yaml
```yaml
# Copyright (c) 2025 cormoran
# SPDX-License-Identifier: MIT

description: Behavior to trigger a behavior-animations overlay by index

compatible: "zmk,behavior-animation-trigger"

include: two_param.yaml
```

## dts/bindings/zmk,animation.yaml
```yaml
# Copyright (c) 2020, The ZMK Contributors
# SPDX-License-Identifier: MIT

description: |
  Global animation engine configuration. Exactly one enabled instance is
  supported. The engine reads the `zmk,animation` chosen node only for
  activity-gating (start/stop/is_finished); from Phase B onward that chosen
  node must resolve to the `zmk,animation-control` singleton, not a bare
  animation node (DESIGN.md #4 item 10) - control.c is what actually decides
  which animation gets rendered each tick.

compatible: "zmk,animation"

properties:
  drivers:
    type: phandles
    required: true
    description: |
      This array should contain all driver devices responsible for illuminating animated LEDs.
      The devices must implement Zephyr's LED Strip Interface.
  chain-lengths:
    type: array
    required: true
    description: |
      This field contains the number of LEDs controlled by each driver device.
  pixels:
    type: phandle-array
    required: true
    description: |
      This field contains the pixel configuration for the entire board.
      The order of this array determines in what order pixels are sent to the driver device API.
      If multiple driving devices are used, their chain-length property determines the size of the buffer for each device.
  key-pixels:
    type: array
    description: |
      Use this field to specify the pixel index corresponding to each key
      following the order used in your keymap.
      When left unspecified, the driver assumes that for every key, the pixel has a matching id.
      So for N keys, the first N pixels are exactly in the same order as keys in your keymap.
```

## dts/bindings/zmk,mock-led-strip.yaml
```yaml
description: Mock LED strip for animation testing

compatible: "zmk,mock-led-strip"

properties:
  chain-length:
    type: int
    required: true
    description: Number of LEDs in the strip
```
