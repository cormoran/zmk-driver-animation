## Kconfig
```kconfig
config ZMK_ANIMATION
    bool "RGB Animations"
    select LED_STRIP

if ZMK_ANIMATION

config ZMK_ANIMATION_FPS
    int "Animation FPS"
    range 1 60
    default 30

config ZMK_ANIMATION_STOP_ON_IDLE
    bool "Whether to stop animation on idle state or not"
    default y

config ZMK_ANIMATION_STUDIO_RPC
    bool "Enable animation feature custom Studio RPC"
    depends on ZMK_STUDIO

config ZMK_ANIMATION_STUDIO_RPC_TEST
    bool "Enable native_sim-only Studio RPC round-trip test hook"
    depends on ZMK_ANIMATION_STUDIO_RPC
    help
      Adds a boot-time self-test (see tests/studio) that calls
      zmk_animation_request_exec_handle() directly (bypassing RPC framing -
      there is no serial/BLE transport in native_sim) for every request kind
      defined in animation.proto, and logs the decoded response fields so
      tests/studio's events.patterns/keycode_events.snapshot mechanism can
      assert on them the same way every other native_sim test in this repo
      does. Also drives a non-RPC state change (calling control.h directly,
      the same path a keymap behavior would use) to prove
      Notification.state_changed fires from that path too, not just from
      RPC-originated mutations.

config ZMK_ANIMATION_CUSTOM_SETTINGS
    bool "Enable animation runtime settings via zmk-feature-custom-settings"
    depends on ZMK_CUSTOM_SETTINGS
    help
      Registers the animation-control state (enabled, powered/battery
      brightness, powered/battery animation selection) as custom settings
      (subsystem "cormoran__animation"), readable/writable over the generic
      custom-settings Studio RPC subsystem and persisted via the Zephyr
      settings subsystem. NOTE: unlike the equivalent PMW3610 option, this
      currently depends on CONFIG_ZMK_ANIMATION itself (nested in this
      `if ZMK_ANIMATION` block): control.h's public API only has a "no
      device" stub definition inside control.c, which is only compiled when
      CONFIG_ZMK_ANIMATION=y (there is no standalone api_stub.c yet - see
      DESIGN.md's Phase D note about adding one for the RPC layer). Revisit
      this dependency once that stub is split out.

config ZMK_ANIMATION_TRIGGER_MAX_PARALLELISM
    int "Maximum number of simultaneously-triggered behavior-animations slots"
    default 10
    help
      v1 spelled this option "...PARALELISM" (typo). Renamed for Phase B;
      see README migration notes if porting a v1 keymap fragment that sets
      this directly (most users only reference the behavior, not this
      Kconfig symbol).

config ZMK_ANIMATION_TRIGGER_MAX_DURATION_MS
    int "Maximum animation play duration for animation trigger"
    default 10000

config ZMK_ANIMATION_TRIGGER_MIN_DURATION_MS
    int "Minimum animation play duration for animation trigger"
    default 1000

config ZMK_ANIMATION_TRIGGER_EXTEND_MS_ON_HOLD
    int "Animation play duration extension on hold"
    default 500

config ZMK_ANIMATION_LAYER_STATUS_SPLIT_TEST
    bool "Enable native_sim-only layer-status split-peripheral test hook"
    depends on ZMK_SPLIT && !ZMK_SPLIT_ROLE_CENTRAL
    help
      Adds a boot-time self-test (see tests/layer_status_peripheral) that
      invokes the `animls` behavior's binding directly - bypassing kscan,
      since a split-peripheral native_sim build forwards raw kscan events
      to the (nonexistent, in this test) central rather than resolving
      keymap bindings locally, so a keymap binding alone cannot exercise
      this path in native_sim. This asserts the real
      on_keymap_binding_pressed/released behavior-invocation path end to
      end, not just the internal zmk_animation_layer_status_set_status()
      call it wraps.

config ZMK_ANIMATION_SETTINGS_TEST
    bool "Enable native_sim-only custom-settings persistence test hook"
    depends on ZMK_ANIMATION_CUSTOM_SETTINGS
    help
      Adds a fake settings backend (see tests/settings_apply) that seeds a
      persisted, non-default value for one animation setting before ZMK's
      main() calls settings_load(), so the test can assert that
      animation-control's boot-time settings-apply step (control.c's
      init-animation delayed work, DESIGN.md #3.5) picks up the persisted
      value rather than the devicetree/Kconfig default - proving the
      boot-ordering fix (this file's SYS_INIT runs at APPLICATION priority
      99, before ZMK's main()/settings_load(), mirroring
      zmk-feature-custom-settings' own CONFIG_ZMK_CUSTOM_SETTINGS_TEST).

config ZMK_ANIMATION_NOTIFY_AMPLIFICATION_TEST
    bool "native_sim-only regression test for the state-changed notification storm"
    depends on ZMK_ANIMATION_SETTINGS_TEST
    help
      Runs an extra hook in the shared animation-settings test init that
      installs a counting state-changed callback, performs a single
      zmk_animation_set_brightness() mutation, and logs how many
      notifications fired. Guards the regression where a mutation re-enters
      apply_all() and amplifies into a burst of state-changed notifications
      (hardware-confirmed to starve that mutation's own RPC Response frame;
      see docs/design/hardware-validation.md). Enabled only in
      tests/settings_write_through, so the mutation it performs does not
      perturb the boot-apply snapshots in tests/settings_apply* (which share
      this same test hook).

endif

config ZMK_ANIMATION_MOCK_LED_STRIP
    bool "Mock LED strip for animation testing"
    depends on ZMK_ANIMATION
    select LED_STRIP
```

## boards/shields/tester_xiao/Kconfig.defconfig
```kconfig
if SHIELD_TESTER_XIAO

config ZMK_KEYBOARD_NAME
    default "Tester XIAO"

config ZMK_BLE
    def_bool n

config SETTINGS
    def_bool n

endif
```

## boards/shields/tester_xiao_animation/Kconfig.defconfig
```kconfig
if SHIELD_TESTER_XIAO_ANIMATION

config ZMK_KEYBOARD_NAME
    default "Tester XIAO Animation"

config ZMK_BLE
    def_bool n

config SETTINGS
    def_bool n

endif
```

## boards/shields/tester_xiao_animation/Kconfig.shield
```kconfig
config SHIELD_TESTER_XIAO_ANIMATION
    def_bool $(shields_list_contains,tester_xiao_animation)
```

## dts/bindings/animations/animation_base.yaml
```yaml
# Copyright (c) 2020, The ZMK Contributors
# SPDX-License-Identifier: MIT

description: |
  Shared base properties for animation nodes. Note: v1's `blending-mode`
  property is intentionally not included here (dead code, no consumer -
  see DESIGN.md #4 item 5); revival is tracked as an extension idea.

properties:
  pixels:
    type: array
    required: true
    description: |
      Pixel positions to which the animation should apply.
```

## dts/bindings/animations/zmk,animation-battery-status.yaml
```yaml
# Copyright (c) 2020, The ZMK Contributors
# SPDX-License-Identifier: MIT

description: |
  Breathing bar-graph of the current battery percentage, plus a low-battery
  alert enqueued as an ad-hoc overlay through control.h (DESIGN.md - not a
  bespoke mechanism).
compatible: "zmk,animation-battery-status"
include: animation_base.yaml

properties:
  animation-duration-seconds:
    type: int
    default: 1
    description: |
      Duration in seconds of one breathing cycle.
  color-high:
    type: int
    required: true
  color-middle:
    type: int
    required: true
  color-low:
    type: int
    required: true
  low-alert-start-threshold:
    type: int
    default: 10
    description: |
      Battery percentage below which the low-battery alert starts firing.
  low-alert-stop-threshold:
    type: int
    default: 5
    description: |
      Battery percentage below which the low-battery alert stops firing
      (to avoid draining the battery further with the alert itself).
  low-alert-interval-seconds:
    type: int
    default: 60
    description: |
      Minimum time between low-battery alert overlays.
  low-alert-duration-ms:
    type: int
    default: 10
    description: |
      Duration of the low-battery alert overlay in milliseconds.
```

## dts/bindings/animations/zmk,animation-compose.yaml
```yaml
# Copyright (c) 2025, cormoran
# SPDX-License-Identifier: MIT

description: |
  Static (DT-defined) composition of child animations, played either in
  parallel or sequentially. See control/overlay_queue.c for the *runtime*
  ad-hoc sequencing mechanism (DESIGN.md #3.3) - this node is for a fixed
  composition known at devicetree-authoring time.

compatible: "zmk,animation-compose"

properties:
  animations:
    type: phandles
    required: true
    description: |
      Child animations to compose.

  durations-ms:
    type: array
    required: true
    description: |
      Duration of each child animation in milliseconds, same order as
      `animations`. For a parallel composition, each duration is
      additionally capped by `start()`'s request_duration_ms when one is
      given.

  parallel:
    type: boolean
    description: |
      If true, all children play in parallel; the composition finishes when
      all children finish. If false (default), children play sequentially
      in DT order; the composition finishes when the last one finishes.
```

## dts/bindings/animations/zmk,animation-control.yaml
```yaml
# Copyright (c) 2020, The ZMK Contributors
# Copyright (c) 2026, cormoran
# SPDX-License-Identifier: MIT

description: |
  Control singleton: enable/disable, brightness, and per-power-source
  animation selection, plus the ad-hoc overlay queue (DESIGN.md #3.3/#3.4).

  Exactly one enabled instance is supported (BUILD_ASSERT in control.c, like
  engine.c's). It must be referenced by the `zmk,animation` chosen node (the
  engine renders whichever device that resolves to - v1's README/behavior
  mismatch where `zmk,animation` sometimes pointed at a bare animation node
  instead of animation-control, DESIGN.md #4 item 10). A second chosen
  property, `zmk,animation-control`, is used internally by animations that
  need to enqueue an ad-hoc overlay (battery-status's low-battery alert,
  etc.) and must point at the same node.

compatible: "zmk,animation-control"

properties:
  powered-animations:
    type: phandles
    required: true
    description: |
      Base animations selectable while USB-bus-powered.

  battery-animations:
    type: phandles
    required: true
    description: |
      Base animations selectable while battery-powered.

  behavior-animations:
    type: phandles
    required: true
    description: |
      Animations playable as an ad-hoc overlay via animtrig/animctl/RPC
      trigger, referenced by index into this list.

  init-animation:
    type: phandle
    description: |
      Animation played as an ad-hoc overlay shortly after boot.

  init-animation-duration-ms:
    type: int
    default: 0
    description: |
      Duration of the init animation in milliseconds. 0 plays it until it
      finishes.

  init-animation-delay-ms:
    type: int
    default: 100
    description: |
      Delay after startup before the init animation is enqueued. Also the
      point at which persisted settings are applied in Phase C - see
      DESIGN.md #3.5.

  activation-animation:
    type: phandle
    description: |
      Animation played as an ad-hoc overlay when resuming from idle/sleep.

  activation-animation-duration-ms:
    type: int
    default: 0
    description: |
      Duration of the activation animation in milliseconds. 0 plays it
      until it finishes.

  ext-power:
    type: phandle
    description: |
      Power switch for the LED strip. Disabled while no animation is
      selected or the engine is stopped (idle/sleep); enabled while
      something is playing.

  brightness-steps:
    type: int
    default: 10
    description: |
      Number of brightness steps supported (0..brightness-steps inclusive).

  max-brightness:
    type: int
    default: 128
    description: |
      Maximum per-channel RGB value (0..255) at the top brightness step.

  default-powered-brightness:
    type: int
    default: 1
    description: |
      Default brightness step while USB-bus-powered.

  default-battery-brightness:
    type: int
    default: 1
    description: |
      Default brightness step while battery-powered.

  queue-size:
    type: int
    default: 16
    description: |
      Capacity of the ad-hoc overlay queue.
```

## dts/bindings/animations/zmk,animation-endpoint.yaml
```yaml
# Copyright (c) 2020, The ZMK Contributors
# SPDX-License-Identifier: MIT

description: |
  Animation for displaying endpoint status (BLE connection status & USB).
  Central and split-peripheral roles render differently (DESIGN.md #3.8):
  central shows per-BLE-profile status plus USB; peripheral shows only the
  central-connection status.
compatible: "zmk,animation-endpoint"
include: animation_base.yaml

properties:
  duration-seconds-on-endpoint-change:
    type: int
    default: 1
    description: |
      Animation duration in seconds when the endpoint changes. Extended to
      not-connected-duration-seconds if the current BLE profile is not
      connected. 0 disables playing on endpoint change.
  not-connected-duration-seconds:
    type: int
    default: 5
    description: |
      Duration in seconds while the current profile/central is not
      connected.
  blink-duration-seconds:
    type: int
    default: 1
    description: |
      Duration in seconds for one blink cycle.
  extend-duration-seconds:
    type: int
    default: 2
    description: |
      Duration to extend by if BLE status changes while already playing.
  event-handling-start-seconds:
    type: int
    default: 2
    description: |
      Ignore endpoint-change events during this many seconds after boot
      (avoids an animation burst while BLE/USB settle at startup).
  color-open:
    type: int
    required: true
  color-connected:
    type: int
    required: true
  color-disconnected:
    type: int
    required: true
  color-usb:
    type: int
    required: true
```

## dts/bindings/animations/zmk,animation-layer-status.yaml
```yaml
# Copyright (c) 2020, The ZMK Contributors
# SPDX-License-Identifier: MIT

description: |
  Animation for active layer status: pixels[i] lights up when layer[i +
  layer-offset] is active. On a split keyboard, the central computes the
  layer bitmask and relays it to the peripheral via the `animls` behavior
  (a quarantined transport hack, DESIGN.md #3.7/#3.8 - not an RPC/settings
  concern).

compatible: "zmk,animation-layer-status"
include: animation_base.yaml

properties:
  default-color:
    type: int
    description: |
      HSL color (packed via the HSL() macro) used for an active layer that
      has no per-layer color in `colors` (or whose color is all-zero).
  colors:
    type: array
    description: |
      Per-layer HSL colors. A layer uses `default-color` if this array is
      too short to cover it, or its entry is all-zero.
  layer-offset:
    type: int
    default: 0
    description: |
      Maps layer i to pixels[i - layer-offset], so a split board can spread
      layer indicators across both halves' LEDs.
  extend-duration-seconds:
    type: int
    default: 2
    description: |
      Duration to extend the animation by if the layer status changes while
      it is already playing.
```

## dts/bindings/animations/zmk,animation-none.yaml
```yaml
# Copyright (c) 2026 cormoran
# SPDX-License-Identifier: MIT

description: |
  Null-object animation: initializes successfully and renders nothing
  (pixels stay at whatever the engine reset them to, i.e. black). Used to
  represent "no animation selected" without the readiness-as-sentinel hack
  v1 used for its "empty" animation (DESIGN.md #4 item 9).
compatible: "zmk,animation-none"

properties:
  display-name:
    type: string
    description: |
      Human-readable name for this animation, surfaced by the Studio RPC
      GetInfoResponse (Phase D). Falls back to the DT node name when unset.
```
